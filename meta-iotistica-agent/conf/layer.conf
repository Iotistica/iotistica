## meta-iotistica-agent/conf/layer.conf
```bitbake
BBPATH .= ":${LAYERDIR}"

BBFILES += "${LAYERDIR}/recipes-*/*/*.bb \
            ${LAYERDIR}/recipes-*/*/*.bbappend"

BBFILE_COLLECTIONS += "iotistica-agent"
BBFILE_PATTERN_iotistica-agent = "^${LAYERDIR}/"
BBFILE_PRIORITY_iotistica-agent = "7"

LAYERDEPENDS_iotistica-agent = "core"
LAYERSERIES_COMPAT_iotistica-agent = "kirkstone scarthgap"
```
